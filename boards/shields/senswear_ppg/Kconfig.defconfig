## boards/shields/senswear_ppg/Kconfig.defconfig
```kconfig
# SPDX-License-Identifier: Apache-2.0

if SHIELD_SENSWEAR_PPG

config I2C
	default y

config SENSWEAR_SYS_I2C
	default y

config GPIO
	default y

config SENSOR
	default y

config REGULATOR
	default y

config SENSWEAR_TPSM83102_DRIVER
	default y

config SENSWEAR_DAUGHTER_IF_DRIVER
	default y

config SENSWEAR_DEVICE_DRIVER_EVENTS
	default y

endif # SHIELD_SENSWEAR_PPG
```

## boards/shields/senswear_ppg/Kconfig.shield
```kconfig
# SPDX-License-Identifier: Apache-2.0

config SHIELD_SENSWEAR_PPG
	def_bool $(shields_list_contains,senswear_ppg)
```

## boards/shields/senswear_temperature/Kconfig.defconfig
```kconfig
# SPDX-License-Identifier: Apache-2.0

if SHIELD_SENSWEAR_TEMPERATURE

config I2C
	default y

config SENSWEAR_SYS_I2C
	default y

config GPIO
	default y

config SENSOR
	default y

config SENSWEAR_TPSM83102_DRIVER
	default y


endif # SHIELD_SENSWEAR_TEMPERATURE
```

## boards/shields/senswear_temperature/Kconfig.shield
```kconfig
# SPDX-License-Identifier: Apache-2.0

config SHIELD_SENSWEAR_TEMPERATURE
	def_bool $(shields_list_contains,senswear_temperature)
```

## boards/shields/senswear_touch/Kconfig.shield
```kconfig
# SPDX-License-Identifier: Apache-2.0

config SHIELD_SENSWEAR_TOUCH
	def_bool $(shields_list_contains,senswear_touch)
```
