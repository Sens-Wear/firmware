/*
 * SPDX-License-Identifier: Apache-2.0
 */

/ {
	aliases {
		sensewear-daughter = &mtch6102;
		sensewear-touch = &mtch6102;
	};
};

&sys_i2c_peripheral {
	mtch6102: mtch6102@25 {
		compatible = "i2c-device";
		status = "okay";
		reg = <0x25>;
		label = "MTCH6102";
	};
};
