## boards/SenseraTechnologies/SensWear/Kconfig.SensWear
```kconfig
config BOARD_SENSWEAR
	select SOC_NRF54L15_CPUAPP if BOARD_SENSWEAR_NRF54L15_CPUAPP
	select SOC_NRF54L15_CPUFLPR if \
		BOARD_SENSWEAR_NRF54L15_CPUFLPR || \
		BOARD_SENSWEAR_NRF54L15_CPUFLPR_XIP
```

## boards/SenseraTechnologies/SensWear/board.yml
```yaml
board:
  name: SensWear
  full_name: SensWear
  vendor: SenseraTechnologies
  socs:
  - name: nrf54l15
    variants:
    - name: xip
      cpucluster: cpuflpr
```

## boards/SenseraTechnologies/SensWear/dts/bindings/bus/sensewear,sys-i2c.yaml
```yaml
# Copyright (c) 2026
# SPDX-License-Identifier: Apache-2.0

description: |
  SenseWear shared system I2C bus (SYS_I2C).

  A thin ownership-locking wrapper around a Nordic I2C controller. A consumer takes
  ownership of the bus for an atomic, multi-transfer sequence; on acquisition the bus
  is reconfigured for that owner. Physical devices remain standard children of the
  wrapped I2C controller and use their `reg` property as the target address.

compatible: "sensewear,sys-i2c"

include: base.yaml

properties:
  controller:
    type: phandle
    required: true
    description: Underlying Nordic I2C controller this bus wraps (e.g. &i2c21).
```

## boards/SenseraTechnologies/SensWear/dts/bindings/bus/sensewear,sys-spi.yaml
```yaml
# Copyright (c) 2026
# SPDX-License-Identifier: Apache-2.0

description: |
  SenseWear shared system SPI bus (SYS_SPI).

  A thin ownership-locking wrapper around a Nordic SPI controller. A consumer takes
  ownership of the bus for an atomic, multi-transfer sequence; the owner's SPI config
  (frequency, mode, chip-select) is applied on each transfer. Physical devices remain
  standard children of the wrapped SPI controller, with standard `reg`,
  `spi-max-frequency`, and controller `cs-gpios` metadata.

compatible: "sensewear,sys-spi"

include: base.yaml

properties:
  controller:
    type: phandle
    required: true
    description: Underlying Nordic SPI controller this bus wraps (e.g. &spi00).
```

## boards/SenseraTechnologies/SensWear/dts/bindings/charger/sensewear,bq25180.yaml
```yaml
description: SenseWear BQ25180 charger

compatible: "sensewear,bq25180"

include: i2c-device.yaml

properties:
  int-gpios:
    type: phandle-array
    required: true
    description: Active-low charger interrupt GPIO.

  kill-gpios:
    type: phandle-array
    required: true
    description: Power-hold control GPIO.
```

## boards/SenseraTechnologies/SensWear/dts/bindings/charger/senswear,bq25180.yaml
```yaml
description: SensWear BQ25180 charger

compatible: "senswear,bq25180"

include: i2c-device.yaml

properties:
  int-gpios:
    type: phandle-array
    required: true
    description: Active-low charger interrupt GPIO.

  kill-gpios:
    type: phandle-array
    required: true
    description: Power-hold control GPIO.
```

## boards/SenseraTechnologies/SensWear/dts/bindings/connector/senswear,daughter-connector.yaml
```yaml
# Copyright (c) 2026
# SPDX-License-Identifier: Apache-2.0

description: SensWear shared daughter board connector

compatible: "senswear,daughter-connector"

include: gpio-nexus.yaml

properties:
  gpio-line-names:
    type: string-array
    description: Names for the exposed connector GPIO lines (per schematic).

  sensor-gpios:
    type: phandle-array
    description: |
      The connector GPIO lines, in line order, aggregated by the daughter_if
      driver. Each entry references this connector's own gpio-map so the lines
      resolve to the physical controller pins. The driver owns these specs and
      arbitrates which consumer driver may control each line.
```

## boards/SenseraTechnologies/SensWear/dts/bindings/i2c/senswear,daughter-i2c-device.yaml
```yaml
# Copyright (c) 2026
# SPDX-License-Identifier: Apache-2.0

description: |
  Generic I2C daughter-board device on the SensWear daughter connector.

  Behaves like the generic "i2c-device" binding (it includes it) -- the node is
  still addressed by its nodelabel and reg via SYS_I2C_DT_SPEC_GET() -- but adds
  a vin-supply phandle so the device's dependency on the shared daughter rail
  (VDD_DAUGHTER, from the TPSM83102 regulator) is expressed in devicetree. The
  build counts the daughter devices that reference this regulator; the connector
  provides a single regulated rail, so at most one may be present.

  Use this as the first compatible, keeping "i2c-device" as a fallback:
    compatible = "senswear,daughter-i2c-device", "i2c-device";

compatible: "senswear,daughter-i2c-device"

include: i2c-device.yaml

properties:
  vin-supply:
    type: phandle
    description: |
      Regulator supplying the device's input rail (VDD_DAUGHTER / TPSM83102).
```

## boards/SenseraTechnologies/SensWear/dts/bindings/imu/bosch,bhi360.yaml
```yaml
description: Bosch BHI360 IMU (SPI)

compatible: "bosch,bhi360"

include:
  - name: spi-device.yaml

properties:
  reg:
    required: true

  spi-max-frequency:
    required: true

  cs-gpios:
    type: phandle-array
    required: true
    description: |
      Chip-select GPIO owned and driven by this driver (P2.05 BHI360_CS#).
      The SPI controller does not manage chip-select for this device; the
      driver asserts and deasserts this line manually around each transfer.

  int-gpios:
    type: phandle-array
    required: false
    description: Active-low host interrupt (MPU_IRQ#).

  reset-gpios:
    type: phandle-array
    required: false
    description: Active-low reset line (MPU_RESET).

  gpio0-gpios:
    type: phandle-array
    required: false
    description: Auxiliary host GPIO 0 (MPU_GPIO0).

  gpio1-gpios:
    type: phandle-array
    required: false
    description: Auxiliary host GPIO 1 (MPU_GPIO1).
```

## boards/SenseraTechnologies/SensWear/dts/bindings/memory/senswear,m95p.yaml
```yaml
# Copyright (c) 2026
# SPDX-License-Identifier: Apache-2.0

description: SensWear M95P serial page EEPROM

compatible: "senswear,m95p"

include: spi-device.yaml

properties:
  cs-gpios:
    type: phandle-array
    required: true
    description: |
      Chip-select GPIO owned and driven by this driver (P2.03 M95P_CS#).
      The SPI controller does not manage chip-select for this device; the
      driver asserts and deasserts this line manually around each transfer.

  size:
    type: int
    required: true
    description: Memory size in bytes.

  address-width:
    type: int
    required: true
    description: Memory address width in bits.

  pagesize:
    type: int
    required: true
    description: Programmable page size in bytes.

  timeout:
    type: int
    required: true
    description: Device operation timeout in milliseconds.
```

## boards/SenseraTechnologies/SensWear/dts/bindings/rtc/sensewear,rtc.yaml
```yaml
# Copyright (c) 2026
# SPDX-License-Identifier: Apache-2.0

description: |
  SenseWear software real-time clock.

  The nRF54L15 has no battery-backed calendar RTC peripheral, so wall-clock
  timekeeping is maintained in software on top of the GRTC-backed system clock
  (the same time base as Zephyr's SYS_CLOCK_REALTIME / POSIX time()). This node
  exists only to give the rtc driver a devicetree identity and a generated
  device id for the SenseWear device-event manager; it owns no hardware
  registers and consumes no bus.

compatible: "sensewear,rtc"

include: base.yaml
```

## boards/SenseraTechnologies/SensWear/dts/bindings/rtc/senswear,rtc.yaml
```yaml
# Copyright (c) 2026
# SPDX-License-Identifier: Apache-2.0

description: |
  SensWear software real-time clock.

  The nRF54L15 has no battery-backed calendar RTC peripheral, so wall-clock
  timekeeping is maintained in software on top of the GRTC-backed system clock
  (the same time base as Zephyr's SYS_CLOCK_REALTIME / POSIX time()). This node
  exists only to give the rtc driver a devicetree identity and a generated
  device id for the SensWear device-event manager; it owns no hardware
  registers and consumes no bus.

compatible: "senswear,rtc"

include: base.yaml
```

## boards/shields/sensewear_haptic/Kconfig.defconfig
```kconfig
# SPDX-License-Identifier: Apache-2.0

if SHIELD_SENSEWEAR_HAPTIC

config I2C
	default y

config SENSEWEAR_SYS_I2C
	default y

config GPIO
	default y

config SENSEWEAR_TPSM83102_DRIVER
	default y

config SENSEWEAR_DAUGHTER_IF_DRIVER
	default y

config SENSEWEAR_DEVICE_DRIVER_EVENTS
	default y

rsource "drivers/haptic/drv2605/Kconfig.drv2605"

endif # SHIELD_SENSEWEAR_HAPTIC
```

## boards/shields/sensewear_haptic/drivers/haptic/drv2605/Kconfig.drv2605
```kconfig
# Copyright 2024 Cirrus Logic, Inc.
# SPDX-License-Identifier: Apache-2.0
#
# SenseWear local copy:
# Copied from Zephyr/NCS v3.3.0
#   zephyr/drivers/haptics/Kconfig.drv2605
# See PATCHED_FROM_ZEPHYR.md before changing this file.

config SENSEWEAR_DRV2605_DRIVER
	bool "SenseWear DRV2605 haptics driver"
	default y
	depends on DT_HAS_SENSEWEAR_DRV2605_ENABLED
	select HAPTICS
	select I2C
	select GPIO
	select REGULATOR
	select SENSEWEAR_SYS_I2C
	select SENSEWEAR_DEVICE_DRIVER_EVENTS
	help
	  Enable the SenseWear-patched Texas Instruments DRV2605 haptics driver.
	  This copy routes register access through the SenseWear SYS_I2C ownership
	  wrapper, owns the enable pin through the daughter_if GPIO arbiter, and
	  posts playback lifecycle events through the SenseWear device-driver event
	  queue. It binds to the namespaced "sensewear,drv2605" compatible so it
	  replaces, rather than collides with, Zephyr's upstream ti,drv2605 driver.
```

## boards/shields/sensewear_haptic/dts/bindings/haptic/sensewear,drv2605.yaml
```yaml
# Copyright (c) 2024 Cirrus Logic, Inc.
# SPDX-License-Identifier: Apache-2.0
#
# SenseWear local copy:
# Copied from Zephyr/NCS v3.3.0
#   zephyr/dts/bindings/haptics/ti,drv2605.yaml
# See ../../../drivers/haptic/drv2605/PATCHED_FROM_ZEPHYR.md before changing
# this file.
#
# SenseWear local patch: the compatible is namespaced "sensewear,drv2605" so the
# node binds to the SenseWear-patched DRV2605 driver instead of Zephyr's upstream
# ti,drv2605 driver. The enable pin is not described with en-gpios; the patched
# driver claims SENSOR_GPIO_0 through the daughter_if GPIO arbiter.

description: |
  DRV2605 Haptic Driver for ERM and LRA with built-in library and smart-loop
  architecture.

  SenseWear-patched DRV2605 driver. Register access is routed through the
  SenseWear SYS_I2C ownership wrapper and the enable pin is owned through the
  daughter_if GPIO arbiter rather than a devicetree en-gpios property.

compatible: "sensewear,drv2605"

include: i2c-device.yaml

properties:
  actuator-mode:
    required: true
    type: string
    enum:
      - "ERM"
      - "LRA"
  feedback-brake-factor:
    type: string
    enum:
      - "1X"
      - "2X"
      - "3X"
      - "4X"
      - "6X"
      - "8X"
      - "16X"
      - "DISABLED"
    default: "3X"
    description: |
      Selects the feedback gain ratio between braking gain and driving gain.
      According to the datasheet, a value of 2 ("3X") is valid for most
      actuators.
  loop-gain:
    type: string
    enum:
      - "LOW"
      - "MEDIUM"
      - "HIGH"
      - "VERY_HIGH"
    default: "HIGH"
    description: |
      Selects a loop gain for the feedback control. According to the datasheet,
      a value of 2 ("HIGH") is valid for most actuators.
  vib-rated-mv:
    type: int
    default: 3200
    description: |
      Sets the reference voltage for full-scale output during closed-loop
      operation. The default value is inherited from ti,drv260x.yaml in Linux.
  vib-overdrive-mv:
    type: int
    default: 3200
    description: |
      Sets a clamp so that the automatic overdrive is bounded. The default
      value is inherited from ti,drv260x.yaml in Linux.
  in-trig-gpios:
    type: phandle-array
    description: GPIO to trigger ROM waveforms or drive an input signal.
  vin-supply:
    type: phandle
    description: |
      Regulator supplying the device's input rail. On SenseWear this is the
      shared daughter-connector rail (VDD_DAUGHTER) from the TPSM83102, so the
      build can detect how many daughter devices depend on that single regulator.
```

## boards/shields/sensewear_ppg/Kconfig.shield
```kconfig
# SPDX-License-Identifier: Apache-2.0

config SHIELD_SENSEWEAR_PPG
	def_bool $(shields_list_contains,sensewear_ppg)
```

## boards/shields/sensewear_temperature/Kconfig.defconfig
```kconfig
# SPDX-License-Identifier: Apache-2.0

if SHIELD_SENSEWEAR_TEMPERATURE

config I2C
	default y

config SENSEWEAR_SYS_I2C
	default y

config GPIO
	default y

config SENSOR
	default y

config SENSEWEAR_TPSM83102_DRIVER
	default y


endif # SHIELD_SENSEWEAR_TEMPERATURE
```

## boards/shields/sensewear_temperature/Kconfig.shield
```kconfig
# SPDX-License-Identifier: Apache-2.0

config SHIELD_SENSEWEAR_TEMPERATURE
	def_bool $(shields_list_contains,sensewear_temperature)
```

## boards/shields/sensewear_touch/Kconfig.defconfig
```kconfig
# SPDX-License-Identifier: Apache-2.0

if SHIELD_SENSEWEAR_TOUCH

config I2C
	default y

config SENSEWEAR_SYS_I2C
	default y

config GPIO
	default y

config SENSOR
	default y

config REGULATOR
	default y

config SENSEWEAR_TPSM83102_DRIVER
	default y

config SENSEWEAR_DAUGHTER_IF_DRIVER
	default y

config SENSEWEAR_DEVICE_DRIVER_EVENTS
	default y

endif # SHIELD_SENSEWEAR_TOUCH
```

## boards/shields/sensewear_touch/Kconfig.shield
```kconfig
# SPDX-License-Identifier: Apache-2.0

config SHIELD_SENSEWEAR_TOUCH
	def_bool $(shields_list_contains,sensewear_touch)
```

## boards/shields/senswear_haptic/Kconfig.defconfig
```kconfig
# SPDX-License-Identifier: Apache-2.0

if SHIELD_SENSWEAR_HAPTIC

config I2C
	default y

config SENSWEAR_SYS_I2C
	default y

config GPIO
	default y

config SENSWEAR_TPSM83102_DRIVER
	default y

config SENSWEAR_DAUGHTER_IF_DRIVER
	default y

config SENSWEAR_DEVICE_DRIVER_EVENTS
	default y

rsource "drivers/haptic/drv2605/Kconfig.drv2605"

endif # SHIELD_SENSWEAR_HAPTIC
```

## boards/shields/senswear_haptic/Kconfig.shield
```kconfig
# SPDX-License-Identifier: Apache-2.0

config SHIELD_SENSWEAR_HAPTIC
	def_bool $(shields_list_contains,senswear_haptic)
```

## boards/shields/senswear_haptic/drivers/haptic/drv2605/Kconfig.drv2605
```kconfig
# Copyright 2024 Cirrus Logic, Inc.
# SPDX-License-Identifier: Apache-2.0
#
# SensWear local copy:
# Copied from Zephyr/NCS v3.3.0
#   zephyr/drivers/haptics/Kconfig.drv2605
# See PATCHED_FROM_ZEPHYR.md before changing this file.

config SENSWEAR_DRV2605_DRIVER
	bool "SensWear DRV2605 haptics driver"
	default y
	depends on DT_HAS_SENSWEAR_DRV2605_ENABLED
	select HAPTICS
	select I2C
	select GPIO
	select REGULATOR
	select SENSWEAR_SYS_I2C
	select SENSWEAR_DEVICE_DRIVER_EVENTS
	help
	  Enable the SensWear-patched Texas Instruments DRV2605 haptics driver.
	  This copy routes register access through the SensWear SYS_I2C ownership
	  wrapper, owns the enable pin through the daughter_if GPIO arbiter, and
	  posts playback lifecycle events through the SensWear device-driver event
	  queue. It binds to the namespaced "senswear,drv2605" compatible so it
	  replaces, rather than collides with, Zephyr's upstream ti,drv2605 driver.
```
